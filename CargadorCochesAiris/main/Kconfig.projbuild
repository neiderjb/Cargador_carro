## CargadorCochesAiris/main/Kconfig.projbuild
```kconfig
menu "Wifi Manager Configuration"

config DEFAULT_AP_SSID
    string "Access Point SSID"
    default "CAR_CHARGER_AIRIS"
    help
	    SSID (network name) the the esp32 will broadcast.

config DEFAULT_AP_PASSWORD
    string "Access Point Password"
    default "CEMUSA"
    help
	    Password used for the Access Point. Leave empty and set AUTH MODE to WIFI_AUTH_OPEN for no password.

config DEFAULT_AP_CHANNEL
    int "Access Point WiFi Channel"
    default 1
    help
	    Be careful you might not see the access point if you use a channel not allowed in your country.
	
config DEFAULT_AP_IP
    string "Access Point IP Address"
    default "192.168.1.1"
    help
	    This is used for the redirection to the captive portal. It is recommended to leave unchanged.
	
config DEFAULT_AP_GATEWAY
    string "Access Point IP Gateway"
    default "192.168.1.1"
    help
	    This is used for the redirection to the captive portal. It is recommended to leave unchanged.
	
config DEFAULT_AP_NETMASK
    string "Access Point Netmask"
    default "255.255.255.0"
    help
	    This is used for the redirection to the captive portal. It is recommended to leave unchanged.
	
config DEFAULT_AP_MAX_CONNECTIONS
    int "Access Point Max Connections"
    default 4
    help
	    Max is 4.
	
config DEFAULT_AP_BEACON_INTERVAL
    int "Access Point Beacon Interval (ms)"
    default 100
    help
	    100ms is the recommended default.
	
config EXAMPLE_FIRMWARE_UPG_URL
    string "Firmware Upgrade URL"
    default "https://192.168.0.24:8070/main.bin"
    help
        URL of server which hosts the firmware image.

 config EXAMPLE_GPIO_DIAGNOSTIC
        int "Number of the GPIO input for diagnostic"
        range 0 39
        default 4
        help
            Used to demonstrate how a rollback works.
            The selected GPIO will be configured as an input with internal pull-up enabled.
            To trigger a rollback, this GPIO must be pulled low while the message
            `Diagnostics (5 sec)...` which will be on first boot.
            If GPIO is not pulled low then the operable of the app will be confirmed.

endmenu
```
